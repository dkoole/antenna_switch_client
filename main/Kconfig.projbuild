## main/Kconfig.projbuild
```kconfig
menu "SD Card Configuration"

    config SDCARD_PIN_MOSI
        int "MOSI GPIO number"

    config SDCARD_PIN_MISO
        int "MISO GPIO number"

    config SDCARD_PIN_CLK
        int "CLK GPIO number"

    config SDCARD_PIN_CS
        int "CS GPIO number"

endmenu

menu "Switch Configuration"

    config AUTOMODE_PIN_LED
        int "Auto Mode LED GPIO number"

    config ANT1_PIN_LED
        int "ANT1 LED GPIO number"

    config ANT2_PIN_LED
        int "ANT2 LED GPIO number"

    config ANT3_PIN_LED
        int "ANT3 LED GPIO number"

    config ANT4_PIN_LED
        int "ANT4 LED GPIO number"

    config ANT5_PIN_LED
        int "ANT5 LED GPIO number"

    config ANT6_PIN_LED
        int "ANT6 LED GPIO number"

    config AUTOMODE_BUTTON_GPIO
        int "AUTOMODE Button GPIO"
        default 21

endmenu

menu "W5500 Ethernet configuration"

    config ETHERNET_SPI_HOST
        int "SPI Host"
        default 1

    config ETHERNET_SPI_MISO_GPIO
        int "MISO GPIO PIN"
    
    config ETHERNET_SPI_MOSI_GPIO
        int "MOSI GPIO PIN"

    config ETHERNET_SPI_SCLK_GPIO
        int "CLK GPIO PIN"

    config ETHERNET_SPI_CS
        int "CS GPIO PIN"
    
    config ETHERNET_SPI_INTERRUPT
        int "INTERRUPT GPIO PIN"

    config ETHERNET_SPI_PHY_RESET
        int "INTERRUPT GPIO PIN"
        default -1

    config ETHERNET_SPI_PHY_ADDRESS
        int "PHY ADDRESS"
        default 1
endmenu
```
